## zmk-config/Kconfig
```kconfig
menu "Light Group Options"

config LIGHT_GROUP_INTERVAL_MS
       int "Minimum wait between light group updates"
       default 1

endmenu

DT_COMPAT_ZMK_BEHAVIOR_LIGHT_GROUP := zmk,behavior-light-group

config ZMK_BEHAVIOR_LIGHT_GROUP
       bool
       default y

config ZMK_BEHAVIOR_HSV
       bool
       default y
```

## zmk-config/boards/arm/5x5x3/5x5x3_defconfig
```kconfig
CONFIG_SOC_SERIES_NRF52X=y
CONFIG_SOC_NRF52840_QIAA=y
CONFIG_BOARD_5x5x3=y

CONFIG_ZMK_BLE=y
CONFIG_ZMK_USB=y

# Keyboard Ids
CONFIG_ZMK_KEYBOARD_NAME="5x5x3"
CONFIG_USB_DEVICE_MANUFACTURER="willem@dijkstra.xyz"
CONFIG_BT_DIS_MODEL="5x5x3"
CONFIG_BT_DIS_MANUF="willem@dijkstra.xyz"

# Enable MPU
CONFIG_ARM_MPU=y

# Use pinctrl
CONFIG_PINCTRL=y

# enable GPIO
CONFIG_GPIO=y

CONFIG_USE_DT_CODE_PARTITION=y
CONFIG_BUILD_OUTPUT_UF2=y

CONFIG_MPU_ALLOW_FLASH_WRITE=y
CONFIG_NVS=y
CONFIG_SETTINGS_NVS=y
CONFIG_FLASH=y
CONFIG_FLASH_PAGE_LAYOUT=y
CONFIG_FLASH_MAP=y

CONFIG_ZMK_USB_LOGGING=y
CONFIG_ZMK_RTT_LOGGING=n

CONFIG_SPI=y
CONFIG_SPI_NRFX=y
CONFIG_ZMK_RGB_UNDERGLOW=y
CONFIG_WS2812_STRIP=y
CONFIG_ZMK_RGB_UNDERGLOW_EFF_START=2

CONFIG_SHELL=y
CONFIG_SHELL_TAB=y
CONFIG_SHELL_MINIMAL=y
CONFIG_SHELL_LOG_BACKEND=y
CONFIG_FLASH_SHELL=n
CONFIG_ADC_SHELL=n
CONFIG_SHELL_PROMPT_UART="5x5x3$ "
```

## zmk-config/boards/arm/5x5x3/Kconfig.board
```kconfig
# 5x5x3 board configuration

config BOARD_5x5x3
    bool "5x5x3"
    depends on SOC_NRF52840_QIAA

config BOARD_ENABLE_DCDC
    bool "Enable DCDC mode"
    select SOC_DCDC_NRF52X
    default y
    depends on (BOARD_5x5x3)
```

## zmk-config/boards/arm/5x5x3/Kconfig.defconfig
```kconfig
config ZMK_KEYBOARD_NAME
    default "5x5x3"

config ZMK_USB
        default y

config ZMK_BLE
        default y

config BT_CTLR
    default BT

config PINCTRL
    default y

config ZMK_LIGHT_GROUP
    bool "Enable light group mode"
    default y

if ZMK_LIGHT_GROUP

config ZMK_LIGHT_GROUP_EXT_POWER
    bool "Underglow toggling also controls external power"
    default y

config ZMK_LIGHT_GROUP_AUTO_OFF_IDLE
    bool "Turn off lightgroup when keyboard goes into idle state"
    default y

config ZMK_LIGHT_GROUP_AUTO_OFF_USB
    bool "Turn off lightgroup when USB is disconnected"
    default y

config ZMK_LIGHT_GROUP_SPEED
    int "Default effect speed (1-255)"
    default 13

config ZMK_LIGHT_GROUP_ON_START
    bool "Default on state"
    default y

config WS2812_STRIP
    default y

config LED_STRIP
    default y

endif # ZMK_LIGHT_GROUP

if USB

config USB_NRFX
    default y

config USB_DEVICE_STACK
    default y

endif # USB

config SPI
    default y
```

## zmk-config/boards/dijkstra/5x5x3/5x5x3_defconfig
```kconfig
# BLE can be on or off
CONFIG_ZMK_BLE=n
CONFIG_ZMK_USB=y

# Keyboard Ids
CONFIG_ZMK_KEYBOARD_NAME="5x5x3"
CONFIG_USB_DEVICE_MANUFACTURER="willem@dijkstra.xyz"
CONFIG_BT_DIS_MODEL="5x5x3"
CONFIG_BT_DIS_MANUF="willem@dijkstra.xyz"

# Enable MPU
CONFIG_ARM_MPU=y

# Use pinctrl
CONFIG_PINCTRL=y

# enable GPIO
CONFIG_GPIO=y

CONFIG_USE_DT_CODE_PARTITION=y

CONFIG_MPU_ALLOW_FLASH_WRITE=y
CONFIG_NVS=y
CONFIG_FLASH=y
CONFIG_FLASH_PAGE_LAYOUT=y
CONFIG_FLASH_MAP=y

CONFIG_ZMK_USB_LOGGING=y
CONFIG_ZMK_RTT_LOGGING=n

# Configure all we need for ledwork
CONFIG_SPI=y
CONFIG_SPI_NRFX=y
CONFIG_ZMK_RGB_UNDERGLOW=n
CONFIG_ZMK_LIGHT_GROUP=y
CONFIG_ZMK_HID_INDICATORS=y
CONFIG_WS2812_STRIP_SPI=y

# Development settings
CONFIG_ZMK_KSCAN_MATRIX_POLLING=y
CONFIG_STACK_SENTINEL=y
CONFIG_ISR_STACK_SIZE=2048
CONFIG_ZMK_LOW_PRIORITY_THREAD_STACK_SIZE=4096
CONFIG_ZMK_LIGHT_GROUP_AUTO_OFF_IDLE=n

CONFIG_SHELL=y
CONFIG_SHELL_TAB=y
CONFIG_SHELL_TAB_AUTOCOMPLETION=y
CONFIG_SHELL_MINIMAL=y
CONFIG_SHELL_LOG_BACKEND=y
CONFIG_SHELL_BACKEND_SERIAL_RX_RING_BUFFER_SIZE=512
CONFIG_SHELL_BACKEND_SERIAL_TX_RING_BUFFER_SIZE=512
CONFIG_LOG_CMDS=y
CONFIG_DEVICE_SHELL=y
CONFIG_KERNEL_SHELL=y
CONFIG_GPIO_SHELL=y
CONFIG_THREAD_MONITOR=y
CONFIG_THREAD_NAME=y
CONFIG_FLASH_SHELL=n
CONFIG_ADC_SHELL=n
CONFIG_SHELL_PROMPT_UART="5x5x3$ "
```

## zmk-config/dts/bindings/behaviors/zmk,behavior-hsv.yaml
```yaml
description: HSV color definition

include: behavior-metadata.yaml

compatible: "zmk,behavior-hsv"

properties:
  "#color-cells":
    type: int
    required: true
    const: 1

color-cells:
  - hsv
```

## zmk-config/dts/bindings/behaviors/zmk,behavior-led-layout.yaml
```yaml
description: Light layout definition

compatible: "zmk,behavior-led-layout"

properties:
  bindings:
    type: uint8-array
    required: true
    description: Define the layout of the rgb leds
```

## zmk-config/dts/bindings/behaviors/zmk,behaviour-light-group.yaml
```yaml
description: RGB light groups indicators

compatible: "zmk,behavior-light-group"

properties:
  bindings:
    type: uint8-array
    required: true
    description: Define the layout of the rgb leds

child-binding:
  description: Light-group layer to be used in a rgbmap

  properties:
    bindings:
      type: uint8-array
      required: true
      description: Light group assignments per led
    sequence:
      child-binding:
        background:
          type: uint8-array
        desktop:
          type: uint8-array
        volume:
          type: uint8-array
        hid:
          type: uint8-array
        battery:
          type: uint8-array
        layer:
          type: uint8-array
        endpoint:
          type: uint8-array
        profile:
          type: uint8-array
```

## zmk-config/dts/bindings/zmk,color-group.yaml
```yaml
description: |
  Allows defining light group actions composed of multiple layers

compatible: "zmk,color-group"

child-binding:
  description: Colors to be used in led signalling

child-binding:
  properties:
    colors:
      type: phandle-array
      required: true
      description: Colors (in HSV format) to be used to signal events
```

## zmk-config/dts/bindings/zmk,light-group.yaml
```yaml
description: |
  Allows defining light group actions composed of multiple layers

compatible: "zmk,light-group"

child-binding:
  description: Light-group layer to be used in a rgbmap
  properties:
    bindings:
      type: uint8-array
      required: true
      description: Light group assignments per led
```
